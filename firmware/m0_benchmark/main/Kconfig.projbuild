## firmware/m0_benchmark/main/Kconfig.projbuild
```kconfig
menu "Screendeck M0 benchmark"

choice M0_TEAR_MODE
    prompt "MIPI-DSI/LVGL tear-avoid mode under test"
    default M0_TEAR_TRIPLE_PARTIAL
    help
        Select one mode per firmware image. Run the same bounded DISPLAY and
        COMBINED cases for each candidate and compare their machine-readable
        output; changing modes safely requires display reinitialisation.

config M0_TEAR_TRIPLE_PARTIAL
    bool "Triple partial (vendor default)"

config M0_TEAR_DOUBLE_DIRECT
    bool "Double direct"

config M0_TEAR_DOUBLE_FULL
    bool "Double full"

endchoice

config M0_COMBINED_FRAMES
    int "Combined workload frames"
    range 30 300
    default 90

endmenu
```

## firmware/m0_benchmark/sdkconfig.defaults
```kconfig
CONFIG_IDF_TARGET="esp32p4"
CONFIG_ESP32P4_SELECTS_REV_LESS_V3=y
CONFIG_ESP32P4_REV_MIN_1=y
CONFIG_ESPTOOLPY_FLASHMODE_QIO=y
CONFIG_ESPTOOLPY_FLASHSIZE_32MB=y
CONFIG_ESPTOOLPY_FLASHFREQ_80M=y
CONFIG_IDF_EXPERIMENTAL_FEATURES=y
CONFIG_SPIRAM=y
CONFIG_SPIRAM_MODE_HEX=y
CONFIG_SPIRAM_SPEED_200M=y
CONFIG_ESP_MAIN_TASK_STACK_SIZE=8192
CONFIG_FREERTOS_HZ=1000
CONFIG_COMPILER_OPTIMIZATION_PERF=y
```

## firmware/m5_animated_media/sdkconfig.defaults
```kconfig
CONFIG_IDF_TARGET="esp32p4"
CONFIG_ESP32P4_SELECTS_REV_LESS_V3=y
CONFIG_ESP32P4_REV_MIN_1=y
CONFIG_ESPTOOLPY_FLASHMODE_QIO=y
CONFIG_ESPTOOLPY_FLASHSIZE_32MB=y
CONFIG_ESPTOOLPY_FLASHFREQ_80M=y
CONFIG_IDF_EXPERIMENTAL_FEATURES=y
CONFIG_SPIRAM=y
CONFIG_SPIRAM_MODE_HEX=y
CONFIG_SPIRAM_SPEED_200M=y
CONFIG_ESP_MAIN_TASK_STACK_SIZE=8192
CONFIG_FREERTOS_HZ=1000
CONFIG_COMPILER_OPTIMIZATION_PERF=y
CONFIG_TINYUSB_HID_COUNT=1
CONFIG_TINYUSB_VENDOR_COUNT=1
CONFIG_TINYUSB_VENDOR_RX_BUFSIZE=2048
CONFIG_TINYUSB_VENDOR_TX_BUFSIZE=2048
CONFIG_TINYUSB_VENDOR_EPSIZE=512
CONFIG_FATFS_LFN_HEAP=y
CONFIG_FATFS_MAX_LFN=64
CONFIG_BSP_LCD_DPI_BUFFER_NUMS=3
CONFIG_BSP_LCD_COLOR_FORMAT_RGB565=y
CONFIG_PARTITION_TABLE_SINGLE_APP_LARGE=y
```
